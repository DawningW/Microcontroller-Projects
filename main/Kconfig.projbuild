## main/Kconfig.projbuild
```kconfig
menu "Project Configuration"

    config ESP_WIFI_SSID
        string "WiFi SSID"
        default "esp32"
        help
            SSID (network name) for AP mode.

    config ESP_WIFI_PASSWORD
        string "WiFi Password"
        default "password"
        help
            WiFi password (WPA or WPA2) for AP mode.

    config ESP_WIFI_CHANNEL
        int "WiFi Channel"
        range 1 13
        default 1
        help
            WiFi channel (network channel) for AP mode.

    config ESP_MAX_STA_CONN
        int "Maximal connections"
        default 4
        help
            Max number of connections to AP.

    config ESP_MAXIMUM_RETRY
        int "Maximum retry"
        default 5
        help
            Set the Maximum retry to avoid station reconnecting to the AP unlimited when the AP is really inexistent.

    config ESP_BLUETOOTH_NAME
        string "Bluetooth device name"
        default "ESP32"
        help
            Name for bluetooth.
endmenu
```
